## firmware/esp32-hmi/main/Kconfig.projbuild
```kconfig
menu "TV4 simulation HMI"
config TV4_BOARD_REV12
    bool "Enable Waveshare ESP32-S3 Touch LCD 7 Rev 1.2 display/touch (bench only)"
    default n
    help
        Initializes display/touch only, never CAN or machine outputs.
        Enable only after verifying PCB revision and backing up factory firmware.
        The default build is a headless simulation and initializes no peripherals.
config TV4_OTA_MEMORY_BENCH
    bool "Run finite PSRAM workspace allocation probe (explicit bench image only)"
    depends on TV4_BOARD_REV12 && SPIRAM
    default n
    help
        Three allocation/pattern/release cycles after 15 seconds, worker only.
        No HTTPS, OTA installer or machine commands. Not a TLS budget test.
        Requires separate authorization before recording this image on a board.
config TV4_UTC_TLS_BENCH
    bool "Run one explicit UTC/verified HEAD memory probe (diagnostic image only)"
    depends on TV4_BOARD_REV12 && SPIRAM && MBEDTLS_CERTIFICATE_BUNDLE && !TV4_OTA_MEMORY_BENCH
    default n
    help
        Runs SNTP then one verified HTTPS HEAD to the public TV4-CNC repository.
        Changes system UTC, no response body/installer/machine commands.
        Isolated 2026 bench policy, not production TLS budget. Separate board
        authorization needed; ordinary profiles never enable this flag.
config TV4_OTA_ENABLED
    bool "Enable explicit rev12-ota layout, worker and app rollback"
    depends on TV4_BOARD_REV12 && SPIRAM && !TV4_OTA_MEMORY_BENCH && !TV4_UTC_TLS_BENCH
    default n
    help
        Requires a separately authorized USB partition migration. Local public
        trust/context and measured resource policy must be provisioned before
        operator-triggered HTTPS/installation. No key/version defaults, eFuse,
        CAN or motion control. Ordinary profiles retain factory-only layout.
config TV4_OTA_MEMORY_DIAGNOSTICS
    bool "Enable finite OTA memory phase tracing (explicit diagnostic build only)"
    depends on TV4_OTA_ENABLED
    default n
    help
        Uses SDK local minimum windows during boot and operator-requested OTA.
        SDK bookkeeping allocates memory/asserts on failure; diagnostic guards
        are not reservations. A single owner restores global history after each
        window. Adds bounded worker-only logs, no keys/network probes/Flash
        actions by itself. Requires separate exact-image board authorization.
config TV4_OTA_WORKER_STACK_BENCH
    bool "Use 8192-byte unprovisioned OTA worker for explicit memory bench"
    depends on TV4_OTA_MEMORY_DIAGNOSTICS
    default n
    help
        Reserves the same worker stack size as configured OTA, without keys or
        network/install authority. Only an unprovisioned rev12-ota trace build
        accepts this flag. Ordinary and trace-control builds keep their stack.
        It does not exercise TLS/installation or approve resource floors.
        Requires separate exact-image board authorization before recording.
config TV4_OTA_WORKER_TLS_BENCH
    bool "Run one UTC/verified HEAD in the unprovisioned 8192-byte OTA worker"
    depends on TV4_OTA_WORKER_STACK_BENCH
    default n
    help
        Explicit network diagnostic: after self-test and a 15-second settling
        delay, wait for Wi-Fi, synchronize unauthenticated SNTP, then issue one
        certificate-verified HTTPS HEAD. Uses the existing OTA memory monitor;
        no extra task, body download, keys, installer or Flash writes. The
        isolated 2026 time policy is not production authority. Requires a new
        exact-image board authorization; default and trace-control builds do
        not perform this probe.
config TV4_OTA_SIGNED_CHECK_BENCH
    bool "Run one configured read-only signed CHECK after Wi-Fi settles"
    depends on TV4_OTA_MEMORY_DIAGNOSTICS && !TV4_OTA_WORKER_STACK_BENCH && !TV4_OTA_WORKER_TLS_BENCH
    default n
    help
        Explicit local configured bench only: one existing worker, reviewed
        public trust/context required. Wait at most45 seconds for healthy Wi-Fi,
        then perform exactly one guarded CHECK with signature/full-image checks.
        CHECK/INSTALL/REBOOT commands are rejected in this image; cancellation
        remains available. No Flash sink, extra task, or automatic retry.
        Ordinary profiles keep this flag off.
config TV4_OTA_RESTART_TRACE
    bool "Trace operator-requested post-INSTALL restart (diagnostic image only)"
    depends on TV4_OTA_MEMORY_DIAGNOSTICS && !TV4_OTA_WORKER_STACK_BENCH && !TV4_OTA_WORKER_TLS_BENCH && !TV4_OTA_SIGNED_CHECK_BENCH
    default n
    help
        Configured receiver only, with an explicitly reviewed local INSTALL
        policy. Register the existing IRAM/DRAM shutdown markers before any
        update operation. Preserve CHECK/INSTALL/REBOOT operator commands,
        trust, time, resources, inactive-slot writes and original SDK reset.
        No automatic network request or restart, extra task, persistent marker,
        or reset override. A registration failure blocks update commands before
        any write; no new failing condition is inserted after boot selection.
        Not a release payload; separate finite isolated-board scope is required.
config TV4_OTA_RESTART_BENCH
    bool "Trace one software restart from the OTA worker (diagnostic image only)"
    depends on TV4_OTA_MEMORY_DIAGNOSTICS && !TV4_OTA_WORKER_STACK_BENCH && !TV4_OTA_WORKER_TLS_BENCH && !TV4_OTA_SIGNED_CHECK_BENCH && !TV4_OTA_RESTART_TRACE
    default n
    help
        Unprovisioned HMI only, same 12288-byte worker as configured OTA.
        After a power-on/external reset, self-test and 45 seconds of normal
        HMI/Wi-Fi operation, emit bounded shutdown markers and restart once.
        SW/watchdog/panic/unknown boots do not trigger another restart.
        No SNTP, HTTPS, update installation or persistent marker writes.
        An IRAM/DRAM boundary wrapper calls the unchanged SDK restart.
        Network update commands are blocked. Separate isolated-board scope
        is required before any device operation; ordinary profiles stay off.
endmenu
```
